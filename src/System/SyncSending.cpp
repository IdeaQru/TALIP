#include "System/SyncSending.h"

void SYNC :: sendGoalPost(int *goalPost) {
    
  static unsigned char y, dat[150];

  dat[0] = (0xFF); //header 1
  dat[1] = (0xFF); //header 2
  dat[2] = 0xFE; //broadcast

  dat[4] = 0x83; //instruksi sinkronize write
  dat[5] = 0x1E; //address posisi
  dat[6] = 0x02; //instruksi berapa byte yg dikirim (2 byte, LSB dan MSB untuk posisi)

  for (int mInc = 0; mInc < 10; mInc++) { //10 = ID terakhir. ID awal dimulai dari 0
    dat[7  + (3 * mInc)] = mInc + 1; //ID
    dat[8  + (3 * mInc)] = goalPost[mInc] & 0x00ff; //Parameter Low
    dat[9  + (3 * mInc)] = goalPost[mInc] >> 8;  //Parameter High
  }

  dat[3] = 34; // ((L + 1) * N ) + 4, L:Panjang Data, N:Jumlah DYNAMIXEL
               // ((2 +1 ) * 10) +4 = 34
  //Data Terakhir selain Header untuk check SUM
  //Data iii < 37 dari: ((ID terakhir X  5) + 6 + 1) ---> ((10 X 3) + 6 + 1 = 37) sehingga iii < 37
  for (int mInc = 2; mInc < 37; mInc++) {
    y += dat[mInc];
  }

  dat[37] = (~y); //Data dari iii = 2 ~ iii = 33 ditampung pada iii= 34 (lanjutannya)
  for (int mInc = 0; mInc <= 37; mInc++) {
    Serial1.write(dat[mInc]);
    
//    HAL_UART_Transmit(&huart1, &dat[mInc],1,1);
  } y = 0;
//  HAL_Delay(5);
delayMicroseconds(10);

}

void SYNC::sendGoalXL(int *positions, int *speeds) {
    static unsigned char dat[200];

    // Header paket Dynamixel Protocol 2.0
    dat[0] = 0xFF;
    dat[1] = 0xFF;
    dat[2] = 0xFD;
    dat[3] = 0x00;
    dat[4] = 0xFE; // Broadcast ID

    // Data Length
    const int jumlah_servo = 14;
    const int param_per_servo = 5; // [ID][Pos_L][Pos_H][Spd_L][Spd_H]
    uint16_t param_length = jumlah_servo * param_per_servo;
    uint16_t data_length = param_length + 7; // 7 byte header SYNC_WRITE

    dat[5] = data_length & 0xFF;
    dat[6] = (data_length >> 8) & 0xFF;
    dat[7] = 0x83; // SYNC_WRITE instruction
    dat[8] = 0x1E; // Start address Goal Position (XL430: 0x1E)
    dat[9] = 0x00;
    dat[10] = 0x04; // Data length per servo: 4 bytes (2 pos + 2 speed)
    dat[11] = 0x00;

    // Parameter: [ID][Pos_L][Pos_H][Spd_L][Spd_H] untuk tiap servo
    for (int i = 0; i < jumlah_servo; i++) {
        dat[12 + (i * param_per_servo)] = servoIDsXL[i];
        dat[13 + (i * param_per_servo)] = positions[i] & 0xFF;
        dat[14 + (i * param_per_servo)] = (positions[i] >> 8) & 0xFF;
        dat[15 + (i * param_per_servo)] = 1023 & 0xFF;
        dat[16 + (i * param_per_servo)] = (1023 >> 8) & 0xFF;
    }

    // CRC
    uint16_t crc_index = 12 + (jumlah_servo * param_per_servo);
    uint16_t crc = update_crc320(0, dat, crc_index); // Pastikan fungsi CRC benar
    dat[crc_index]     = crc & 0xFF;
    dat[crc_index + 1] = (crc >> 8) & 0xFF;

    // Kirim paket
    uint16_t packet_length = crc_index + 2;
    for (int cnt = 0; cnt < packet_length; cnt++) {
        Serial2.write(dat[cnt]);
    }
    delayMicroseconds(10); // Bisa diperbesar jika perlu
}
unsigned short update_crc320(unsigned short crc_accum, unsigned char *dat_blk_ptr, unsigned short dat_blk_size)
{
  unsigned short i, j;
  unsigned short crc_table[256] = {
      0x0000, 0x8005, 0x800F, 0x000A, 0x801B, 0x001E, 0x0014, 0x8011,
      0x8033, 0x0036, 0x003C, 0x8039, 0x0028, 0x802D, 0x8027, 0x0022,
      0x8063, 0x0066, 0x006C, 0x8069, 0x0078, 0x807D, 0x8077, 0x0072,
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      0x8213, 0x0216, 0x021C, 0x8219, 0x0208, 0x820D, 0x8207, 0x0202};

  for (j = 0; j < dat_blk_size; j++)
  {
    i = ((unsigned short)(crc_accum >> 8) ^ dat_blk_ptr[j]) & 0xFF;
    crc_accum = (crc_accum << 8) ^ crc_table[i];
  }
  return crc_accum;
}
